## CMakeLists.txt
```
cmake_minimum_required(VERSION 3.20.0)
find_package(Zephyr REQUIRED HINTS $ENV{ZEPHYR_BASE})
project(nrf54l15_sniffer)

# shared/ is a peer of both firmwares, belonging to neither: nothing about
# the wire format is specific to a board, and while it lived inside the
# C6's tree this build reached into the other board's directory to get it.
#
# frame.c is COMPILED here, not copied: two implementations of one wire
# format drift, and the drift would be invisible -- a capture from one
# board would decode and a capture from the other would not, with nothing
# to say which was wrong.
#
# Byte-identity between the boards is therefore a property of the build rather
# than something the tests have to catch. The golden vectors go back to
# guarding what they were written for, which is drift between C and Python.
target_sources(app PRIVATE
    src/main.c
    src/link.c
    src/radio154.c
    src/control.c
    src/log_backend_sn.c
    ../shared/frame.c
)
target_include_directories(app PRIVATE ../shared)

# Mirrors firmware/main/CMakeLists.txt, so both boards are driven the same way.
#   west build -b xiao_nrf54l15/nrf54l15/cpuapp -- -DSN_MODE=0
# SN_MODE 0 = conformance burst (default, used by the host test suite)
# SN_MODE 2 = capture
if(DEFINED SN_MODE)
    target_compile_definitions(app PRIVATE SN_MODE=${SN_MODE})
endif()
```

## prj.conf
```kconfig
# No USB anywhere in this file, deliberately. The nRF54L15 has no USB device
# controller -- within the nRF54L family that is the LM20A and LM20B only --
# so the host is reached through the board's SAMD11 CMSIS-DAP bridge over a
# UART. Nordic's own 802154_sniffer sample configures CDC-ACM and cannot run
# here for exactly that reason.

CONFIG_SERIAL=y
# link.c hands whole spans to EasyDMA (uart_tx) and receives asynchronously
# (uart_rx_enable), which needs this API rather than the interrupt-driven one.
# Two reasons, both measured: DMA reaches 94% of line rate where per-byte
# uart_poll_out reached 78%, and sn_link_send() no longer blocks its caller --
# which is the radio driver's RX thread. At 115200 a 130-byte frame used to
# hold that thread for about 11 ms. See docs/2026-09-14-nrf54l15-spike.md.
#
# Without this the build still succeeds and the board says nothing at all:
# uart_callback_set() returns -ENOTSUP, sn_link_init() fails, main() returns.
CONFIG_UART_ASYNC_API=y

# The capture stream owns the UART. There is only one, so anything else
# writing to it puts unframed bytes into the data path -- which is precisely
# what test_no_unframed_bytes_once_synchronised fails you for. This is not
# tidiness; it is the reason that test exists.
CONFIG_CONSOLE=n
CONFIG_UART_CONSOLE=n
CONFIG_SHELL=n
CONFIG_BOOT_BANNER=n
CONFIG_NCS_BOOT_BANNER=n
CONFIG_PRINTK=n

# Logging travels inside the frame protocol, never to the UART directly.
# LOG_BACKEND_UART=n is the point of the exercise: leaving it on would put raw
# text in the middle of the capture stream.
CONFIG_LOG=y
CONFIG_LOG_BACKEND_UART=n
CONFIG_LOG_MODE_DEFERRED=y
# Compiles log_output.c, which the custom backend formats through. Normally a
# built-in backend selects it; there is no built-in backend here, so it has to
# be asked for.
CONFIG_LOG_OUTPUT=y

# Not optional, and not a performance tweak.
#
# The driver's RX thread defaults to 800 bytes and was measured at 792 used.
# Anything that adds to that stack stops reception -- silently: start()
# returns 0, the channel reads back, promiscuous reads back true, and no frame
# ever arrives. Enabling logging is exactly the kind of thing that adds to it,
# which is why this sits directly beneath the CONFIG_LOG above. Deferred mode
# keeps formatting off that thread; this is the margin that does not depend on
# that remaining true. See docs/2026-09-14-nrf54l15-spike.md.
CONFIG_IEEE802154_NRF5_RX_STACK_SIZE=2048

CONFIG_MAIN_STACK_SIZE=4096

# CONFIG_REGULATOR and CONFIG_REGULATOR_FIXED come from the board's own
# defconfig and must not be turned off: they are what drives rfsw_pwr and
# rfsw_ctl at boot. Without them the RF switch is unpowered and the radio
# reaches its antenna only through leakage -- the same failure
# firmware/main/board.h documents on the C6.

# The radio. These values are the ones Nordic's own 802154_sniffer sample
# uses, read from the installed SDK rather than remembered -- except
# RX_BUFFERS, which their sample sets to 120 for an nRF52840. 16 is plenty
# here and was what reception was finally proved with.
#
# Reception on this part is NOT supported by Nordic and was hard-won. Two
# binaries with byte-identical Kconfig were found to differ deterministically,
# so if frames stop arriving after an unrelated change, read
# docs/2026-09-14-nrf54l15-spike.md before suspecting anything else.
CONFIG_NETWORKING=y
CONFIG_IEEE802154=y
CONFIG_IEEE802154_RAW_MODE=y
CONFIG_NET_PKT_TIMESTAMP=y
CONFIG_NRF_RTC_TIMER_USER_CHAN_COUNT=3
CONFIG_NRF_802154_RX_BUFFERS=16
```

## boards/xiao_nrf54l15_nrf54l15_cpuapp.overlay
```dts
/* The link to the host, as fast as this part can drive it.
 *
 * 1 Mbaud is the UARTE's ceiling on the nRF54L15 -- the register definitions
 * top out there for every instance and every core clock -- so this is the
 * most the USB-C socket can be given. The board default of 115200 carries
 * 11.7 kB/s against the ~31 kB/s an 802.15.4 channel can produce, which is
 * not enough for a busy network.
 *
 * Measured on this path: 94.3 kB/s, 94% of line rate, with EasyDMA.
 * See docs/2026-09-14-nrf54l15-spike.md.
 */
&uart20 {
	current-speed = <1000000>;
};
```

## src/main.c
```c
/* The XIAO nRF54L15 half of the sniffer.
 *
 * Speaks the same wire format as the ESP32-C6 firmware, by compiling the same
 * frame.c rather than reimplementing it. See shared/frame.h.
 */

#include <zephyr/kernel.h>
#include <zephyr/logging/log.h>

#include "control.h"
#include "frame.h"
#include "link.h"
#include "radio154.h"

/* Wire format this firmware speaks. Must match the nrf54l15 entry in
 * EXPECTED_FIRMWARE_VERSIONS in host/src/esp32c6_sniffer/capture.py; the host
 * refuses to open a capture until the two agree, because an older board packs
 * its metadata differently and every field would then decode to a confident
 * wrong number rather than an error. */
#define SN_FIRMWARE_VERSION 1u

LOG_MODULE_REGISTER(sniffer, LOG_LEVEL_INF);

#ifndef SN_MODE
#define SN_MODE 0
#endif

#define SN_MODE_CONFORMANCE 0
#define SN_MODE_CAPTURE     2

uint32_t sn_firmware_version(void)
{
	return SN_FIRMWARE_VERSION;
}

#if SN_MODE == SN_MODE_CONFORMANCE
/* The same burst firmware/main/main.c emits, in the same order, so the host's
 * existing conformance test holds BOTH boards to one set of vectors without
 * knowing there is more than one board. Payloads are transcribed from
 * host/tests/vectors/golden.json; the sequence numbers are assigned by the
 * link at runtime, which is why the host compares types and payloads and then
 * re-encodes to check the bytes. */
static void conformance_burst(void)
{
	static uint8_t all_bytes[256];

	for (int i = 0; i < 256; i++) {
		all_bytes[i] = (uint8_t)i;
	}
	static const uint8_t newline_bytes[] = {0x0a, 0x0d, 0x0a, 0x00, 0xff};
	static const char hello[] = "hello";
	static const char wrap[] = "wrap";
	static const char logmsg[] = "I (123) tag: msg";
	/* A three-entry batch on channel 25 -- base 1000000 us, deltas 0/450/2550,
	 * the last entry a real acknowledgement -- and a ring 48000 bytes deep
	 * with a 128 KB high-water mark of 192 KB capacity. Transcribed from
	 * host/tests/vectors/golden.json; the layouts are authoritative in
	 * host/src/esp32c6_sniffer/batch.py. */
	static const uint8_t batch_three[] = {
		0x40, 0x42, 0x0f, 0x00, 0x00, 0x00, 0x00, 0x00, 0x19, 0x03,
		0x00, 0x00, 0xc8, 0xc4, 0x05, 0x68, 0x65, 0x6c, 0x6c, 0x6f,
		0xc2, 0x01, 0xc7, 0xc3, 0x05, 0x0a, 0x0d, 0x0a, 0x00, 0xff,
		0xf6, 0x09, 0x00, 0x9e, 0x05, 0x02, 0x00, 0x1e, 0x00, 0xf2,
	};
	static const uint8_t link_status[] = {
		0x80, 0xbb, 0x00, 0x00, 0x00, 0x00, 0x02, 0x00, 0x00, 0x00, 0x03, 0x00,
	};

	while (true) {
		sn_link_send(SN_FRAME_HEARTBEAT, NULL, 0);
		sn_link_send(SN_FRAME_PACKET, (const uint8_t *)hello, sizeof(hello) - 1);
		sn_link_send(SN_FRAME_PACKET, newline_bytes, sizeof(newline_bytes));
		sn_link_send(SN_FRAME_PACKET, all_bytes, sizeof(all_bytes));
		sn_link_send(SN_FRAME_PACKET, (const uint8_t *)wrap, sizeof(wrap) - 1);
		sn_link_send(SN_FRAME_LOG, (const uint8_t *)logmsg, sizeof(logmsg) - 1);
		/* PACKET_BATCH and LINK, identical bytes to firmware/main/main.c and
		 * to golden.json, in the same position in the burst. */
		sn_link_send(SN_FRAME_PACKET_BATCH, batch_three, sizeof(batch_three));
		sn_link_send(SN_FRAME_LINK, link_status, sizeof(link_status));
		k_sleep(K_MSEC(500));
	}
}
#endif

#if SN_MODE == SN_MODE_CAPTURE
/* Published once a second, in the short form of the stats payload the host
 * already decodes: five link counters then three for the radio, as
 * sn_link_stats_t and sn_154_stats_t are laid out in the ESP-IDF firmware.
 * The host reads it as "<8I" and zero-fills the Wi-Fi counters it knows this
 * board does not have.
 *
 * frames_dropped_ringfull is now a real measurement: the outbound ring can
 * fill if the host stops draining, and a frame refused at that point is loss
 * the operator should be told about. The rest stay zero deliberately -- this
 * link does not detect short writes or transmit stalls, so reporting anything
 * but zero for those would invent a measurement. */
struct __attribute__((packed)) sn_stats_short {
	uint32_t frames_sent;
	uint32_t frames_dropped_ringfull;
	uint32_t short_writes;
	uint32_t tx_stalls;
	uint32_t bytes_sent;
	uint32_t frames_captured;
	uint32_t isr_queue_full;
	uint32_t link_rejected;
};

static void stats_tick(struct k_work *work);
static K_WORK_DELAYABLE_DEFINE(stats_work, stats_tick);

static void stats_tick(struct k_work *work)
{
	ARG_UNUSED(work);

	const struct sn_stats_short stats = {
		.frames_sent = sn_link_frames_sent(),
		.frames_dropped_ringfull = sn_link_frames_dropped(),
		.short_writes = 0u,
		.tx_stalls = 0u,
		.bytes_sent = sn_link_bytes_sent(),
		.frames_captured = sn_radio154_captured(),
		.isr_queue_full = 0u,
		.link_rejected = sn_radio154_dropped(),
	};

	sn_link_send(SN_FRAME_STATS, (const uint8_t *)&stats, sizeof(stats));
	k_work_schedule(&stats_work, K_SECONDS(1));
}
#endif

int main(void)
{
	if (sn_link_init() != 0) {
		return -1;
	}

#if SN_MODE == SN_MODE_CONFORMANCE
	conformance_burst();
#elif SN_MODE == SN_MODE_CAPTURE
	if (sn_radio154_init() != 0) {
		return -1;
	}
	sn_link_set_command_handler(sn_control_handle);

	/* Travels as a LOG frame, not as bytes on the UART. If this ever
	 * appears as raw text in a capture, the backend is not installed and
	 * the data path is being corrupted. */
	LOG_INF("link up, mode=%d, firmware=%u", SN_MODE, SN_FIRMWARE_VERSION);

	/* The radio is NOT started here. For 802.15.4 the host sends no
	 * separate START -- SET_CHANNEL starts it, as capture.py's _configure
	 * says -- and starting at boot would capture on the default channel
	 * throughout the handshake and then attribute those frames to
	 * whichever channel was finally asked for. */
	k_work_schedule(&stats_work, K_SECONDS(1));

	while (true) {
		k_sleep(K_FOREVER);
	}
#endif
	return 0;
}
```

## src/control.c
```c
/* Control channel, host to board.
 *
 * The host's side is esp32c6_sniffer.control. Commands arrive framed exactly
 * as everything else does, so the same parser handles both directions.
 *
 * Payload layouts, from that module's docstring:
 *   command  5 bytes  "<BI"   command id, then a little-endian 32-bit value
 *   reply    6 bytes  "<BBI"  echoed command id, status, then a value
 *
 * The command id is echoed rather than correlated by sequence number, because
 * the board assigns sequence numbers and the host cannot know them in advance.
 *
 * Only the commands this board can honour are implemented. Every other id gets
 * SN_STATUS_UNKNOWN_COMMAND rather than silence: the host tolerates a reply it
 * does not recognise, but a missing one stalls it until a timeout.
 */

#include "control.h"

#include <zephyr/logging/log.h>

#include <stddef.h>
#include <stdint.h>

#include "commands.h"
#include "frame.h"
#include "link.h"
#include "radio154.h"

LOG_MODULE_REGISTER(control, LOG_LEVEL_INF);

#define SN_CMD_PAYLOAD_LEN   5
#define SN_REPLY_PAYLOAD_LEN 6

static void reply(uint8_t command, uint8_t status, uint32_t value)
{
	uint8_t out[SN_REPLY_PAYLOAD_LEN];

	out[0] = command;
	out[1] = status;
	out[2] = (uint8_t)(value & 0xFFu);
	out[3] = (uint8_t)((value >> 8) & 0xFFu);
	out[4] = (uint8_t)((value >> 16) & 0xFFu);
	out[5] = (uint8_t)((value >> 24) & 0xFFu);

	sn_link_send(SN_FRAME_CONTROL_REPLY, out, sizeof(out));
}

void sn_control_handle(const uint8_t *payload, size_t len)
{
	if (len < SN_CMD_PAYLOAD_LEN) {
		return;
	}
	const uint8_t command = payload[0];
	const uint32_t value = (uint32_t)payload[1] |
			       ((uint32_t)payload[2] << 8) |
			       ((uint32_t)payload[3] << 16) |
			       ((uint32_t)payload[4] << 24);

	switch (command) {
	case SN_CMD_SET_RADIO:
		/* The host selects a radio before anything else, because
		 * SET_CHANNEL is interpreted against whichever is selected.
		 * This board has one: 802.15.4 is Radio.IEEE802154 == 0 in
		 * esp32c6_sniffer.control. Wi-Fi does not exist on this part
		 * at all and BLE has no firmware behind it, so both are
		 * refused rather than quietly accepted. */
		reply(command,
		      value == 0u ? SN_STATUS_OK : SN_STATUS_BAD_VALUE,
		      value);
		break;

	case SN_CMD_SET_CHANNEL:
		/* SET_CHANNEL starts the radio, which is what the host
		 * expects: for 802.15.4 it sends no separate START, and the
		 * comment in capture.py's _configure says so explicitly.
		 * Starting here rather than at boot also means nothing is
		 * captured on the default channel during the handshake and
		 * then attributed to the channel that was asked for. */
		if (sn_radio154_set_channel((uint8_t)value) != 0) {
			reply(command, SN_STATUS_BAD_VALUE, value);
			break;
		}
		/* Worth saying out loud. The operator picked a channel and the
		 * capture is about to be attributed to it, so a mismatch
		 * between what was asked for and what the radio took is the
		 * kind of thing that should be visible rather than inferred. */
		if (sn_radio154_start() != 0) {
			LOG_ERR("channel %u set but the radio would not start",
				(unsigned)value);
			reply(command, SN_STATUS_FAILED, value);
			break;
		}
		LOG_INF("channel %u, receiving", (unsigned)value);
		reply(command, SN_STATUS_OK, value);
		break;

	case SN_CMD_START:
		reply(command,
		      sn_radio154_start() == 0 ? SN_STATUS_OK : SN_STATUS_FAILED,
		      0u);
		break;

	case SN_CMD_STOP:
		reply(command,
		      sn_radio154_stop() == 0 ? SN_STATUS_OK : SN_STATUS_FAILED,
		      0u);
		break;

	case SN_CMD_GET_INFO:
		/* The host refuses to open a capture until this matches
		 * EXPECTED_FIRMWARE_VERSIONS["nrf54l15"], because an older
		 * board packs its metadata differently and every field would
		 * then decode to a confident wrong number rather than an
		 * error. */
		reply(command, SN_STATUS_OK, sn_firmware_version());
		break;

	case SN_CMD_SET_ANTENNA:
		/* This board does have an RF switch, but which position
		 * selects which antenna is not established -- see
		 * docs/2026-09-14-nrf54l15-spike.md.
		 *
		 * Antenna.INTERNAL == 0 is "leave it as the board brought it
		 * up", which is exactly what happens here, so it is honest to
		 * accept it. Asking for the external antenna is refused rather
		 * than accepted and ignored: a control that silently does
		 * nothing is worse than one that says it cannot. */
		reply(command,
		      value == 0u ? SN_STATUS_OK : SN_STATUS_BAD_VALUE,
		      value);
		break;

	default:
		reply(command, SN_STATUS_UNKNOWN_COMMAND, 0u);
		break;
	}
}
```

## src/control.h
```c
#pragma once

#include <stddef.h>
#include <stdint.h>

/* Handles the payload of one SN_FRAME_CONTROL_CMD and replies. Registered with
 * sn_link_set_command_handler, so it runs on the link's reader thread. */
void sn_control_handle(const uint8_t *payload, size_t len);

/* Provided by main.c, so control.c need not see the build-mode macros. */
uint32_t sn_firmware_version(void);
```

## src/link.c
```c
#include "link.h"

#include <errno.h>
#include <string.h>

#include <zephyr/device.h>
#include <zephyr/devicetree.h>
#include <zephyr/drivers/uart.h>
#include <zephyr/kernel.h>
#include <zephyr/sys/ring_buffer.h>

/* The SoC has no USB device controller, so the host is reached through the
 * board's SAMD11 running CMSIS-DAP, which bridges this UART to a USB CDC port.
 *
 * Three things were measured on that path and all three are load-bearing here.
 * See docs/2026-09-14-nrf54l15-spike.md.
 *
 * The UARTE is capped at 1 Mbaud -- silicon, not configuration -- so ~100 kB/s
 * of line rate is the ceiling for anything reaching the USB-C socket. The
 * board's default of 115200 carries 11.7 kB/s against the ~31 kB/s an 802.15.4
 * channel can produce, so the default was not merely slow, it was
 * insufficient. And uart_poll_out() polls a register per byte, which reached
 * only 78% of line rate and, worse, blocks its caller: at 115200 a 130-byte
 * frame holds the radio driver's RX thread for about 11 ms.
 *
 * So frames are encoded into a ring buffer and a separate thread hands whole
 * spans to EasyDMA. sn_link_send() now returns as soon as the bytes are
 * queued, which keeps the radio's receive path moving, and the DMA reaches
 * 94% of line rate instead of 78%.
 */
static const struct device *const uart = DEVICE_DT_GET(DT_CHOSEN(zephyr_console));

static uint16_t seq;
static uint32_t frames_sent;
static uint32_t bytes_sent;
static uint32_t frames_dropped;

/* Outbound bytes waiting for DMA. Sized for roughly a tenth of a second at
 * 1 Mbaud, which covers a burst without letting a stalled host buffer
 * unboundedly: a sniffer that hoards stale frames is worse than one that says
 * it dropped some. */
#define TX_RING_SIZE 8192
RING_BUF_DECLARE(tx_ring, TX_RING_SIZE);
static K_SEM_DEFINE(tx_ready, 0, 1);
static K_SEM_DEFINE(tx_done, 1, 1);
static K_MUTEX_DEFINE(encode_lock);

/* Staging for one encoded frame before it enters the ring. */
static uint8_t scratch[SN_HEADER_LEN + SN_MAX_PAYLOAD];

/* Host to board. Commands are five bytes, so this only ever needs to hold a
 * frame or two. */
#define RX_RING_SIZE 512
RING_BUF_DECLARE(rx_ring, RX_RING_SIZE);

static sn_command_handler_t command_handler;

/* Reassembly buffer for the reader thread. A control frame is 15 bytes; the
 * headroom is for anything the host adds later. */
static uint8_t rx_buf[256];
static size_t rx_len;

void sn_link_set_command_handler(sn_command_handler_t handler)
{
	command_handler = handler;
}

static void uart_cb(const struct device *dev, struct uart_event *evt, void *user_data)
{
	ARG_UNUSED(dev);
	ARG_UNUSED(user_data);

	switch (evt->type) {
	case UART_TX_DONE:
	case UART_TX_ABORTED:
		k_sem_give(&tx_done);
		break;

	case UART_RX_RDY:
		/* A full ring drops the byte rather than blocking in a
		 * callback. The frame it belonged to then fails its header CRC
		 * and is resynchronised past, which is the same recovery the
		 * host's parser makes on a lost byte. */
		ring_buf_put(&rx_ring, evt->data.rx.buf + evt->data.rx.offset,
			     evt->data.rx.len);
		break;

	default:
		break;
	}
}

/* Double-buffered receive, so the driver always has somewhere to put bytes. */
static uint8_t rx_dma[2][64];
static int rx_dma_next;

static void uart_cb_rx(const struct device *dev, struct uart_event *evt, void *user_data)
{
	uart_cb(dev, evt, user_data);

	if (evt->type == UART_RX_BUF_REQUEST) {
		uart_rx_buf_rsp(dev, rx_dma[rx_dma_next], sizeof(rx_dma[0]));
		rx_dma_next ^= 1;
	}
}

/* The SAMD11 bridge overruns during long uninterrupted runs at 1 Mbaud.
 * Measured: 9 bytes lost, twice, both mid-way through the 266-byte
 * conformance frame, and none in a second identical run -- about 90 us of
 * the bridge not draining. Per-byte uart_poll_out never showed it because it
 * left gaps between bytes by accident; EasyDMA streams at exactly line rate
 * and removed them. So each DMA transfer is capped and followed by a short,
 * deliberate gap. At 64 bytes and 20 us that costs about 3% of line rate,
 * against a bridge that otherwise drops a frame every so often. Both are
 * tunables, and both were arrived at by measurement, not taste. */
#define TX_DMA_CHUNK  64
#define TX_DMA_GAP_US 20

static void tx_thread(void *a, void *b, void *c)
{
	ARG_UNUSED(a);
	ARG_UNUSED(b);
	ARG_UNUSED(c);

	while (true) {
		uint8_t *span;
		const uint32_t n = ring_buf_get_claim(&tx_ring, &span, TX_DMA_CHUNK);

		if (n == 0u) {
			ring_buf_get_finish(&tx_ring, 0);
			k_sem_take(&tx_ready, K_FOREVER);
			continue;
		}
		k_sem_take(&tx_done, K_FOREVER);
		if (uart_tx(uart, span, n, SYS_FOREVER_US) != 0) {
			k_sem_give(&tx_done);
			ring_buf_get_finish(&tx_ring, 0);
			k_sleep(K_MSEC(1));
			continue;
		}
		/* Wait for the DMA before releasing the span: the ring must not
		 * hand these bytes out again while the peripheral is reading
		 * them. */
		k_sem_take(&tx_done, K_FOREVER);
		k_sem_give(&tx_done);
		ring_buf_get_finish(&tx_ring, n);

		/* The breath the bridge needs. See the comment above. */
		k_busy_wait(TX_DMA_GAP_US);
	}
}

K_THREAD_DEFINE(sn_link_tx, 1024, tx_thread, NULL, NULL, NULL, 6, 0, 0);

/* Consumes whole frames from rx_buf, dispatching the ones we handle.
 *
 * Resynchronisation is by magic and header CRC, exactly as the host's
 * StreamParser does it: a byte lost in either direction must cost one frame,
 * not the rest of the session. */
static void drain(void)
{
	size_t at = 0;

	while (rx_len - at >= SN_HEADER_LEN) {
		const uint8_t *p = rx_buf + at;
		const uint16_t magic = (uint16_t)p[0] | ((uint16_t)p[1] << 8);

		if (magic != SN_MAGIC) {
			at++;
			continue;
		}
		const uint16_t want_crc = (uint16_t)p[8] | ((uint16_t)p[9] << 8);

		if (sn_crc16(p, 8) != want_crc) {
			at++;
			continue;
		}
		const uint16_t len = (uint16_t)p[6] | ((uint16_t)p[7] << 8);

		if (len > SN_MAX_PAYLOAD) {
			at++;
			continue;
		}
		if (rx_len - at < SN_HEADER_LEN + (size_t)len) {
			break;      /* the rest is still in flight */
		}
		if (p[2] == (uint8_t)SN_FRAME_CONTROL_CMD && command_handler != NULL) {
			command_handler(p + SN_HEADER_LEN, len);
		}
		at += SN_HEADER_LEN + len;
	}

	if (at > 0) {
		memmove(rx_buf, rx_buf + at, rx_len - at);
		rx_len -= at;
	}
	if (rx_len == sizeof(rx_buf)) {
		memmove(rx_buf, rx_buf + sizeof(rx_buf) - SN_HEADER_LEN,
			SN_HEADER_LEN);
		rx_len = SN_HEADER_LEN;
	}
}

static void reader(void *a, void *b, void *c)
{
	ARG_UNUSED(a);
	ARG_UNUSED(b);
	ARG_UNUSED(c);

	while (true) {
		uint8_t chunk[64];
		const uint32_t n = ring_buf_get(&rx_ring, chunk, sizeof(chunk));

		if (n == 0u) {
			k_sleep(K_MSEC(2));
			continue;
		}
		const size_t room = sizeof(rx_buf) - rx_len;
		const size_t take = n < room ? n : room;

		memcpy(rx_buf + rx_len, chunk, take);
		rx_len += take;
		drain();
	}
}

K_THREAD_DEFINE(sn_link_reader, 1024, reader, NULL, NULL, NULL, 7, 0, 0);

int sn_link_init(void)
{
	if (!device_is_ready(uart)) {
		return -ENODEV;
	}
	if (uart_callback_set(uart, uart_cb_rx, NULL) != 0) {
		return -ENOTSUP;
	}
	rx_dma_next = 1;
	(void)uart_rx_enable(uart, rx_dma[0], sizeof(rx_dma[0]), 1000);
	return 0;
}

int sn_link_send(sn_frame_type_t type, const uint8_t *payload, size_t len)
{
	k_mutex_lock(&encode_lock, K_FOREVER);

	const size_t n = sn_frame_encode(scratch, sizeof(scratch), type, seq,
					 payload, len);
	if (n == 0u) {
		k_mutex_unlock(&encode_lock);
		return -EINVAL;
	}

	/* All or nothing. Half a frame in the ring would be indistinguishable
	 * from a corrupted one at the host, and would cost it a resync for no
	 * reason; a frame refused outright is counted and reported instead. */
	if (ring_buf_space_get(&tx_ring) < n) {
		frames_dropped++;
		k_mutex_unlock(&encode_lock);
		return -ENOMEM;
	}
	seq++;
	ring_buf_put(&tx_ring, scratch, n);
	frames_sent++;
	bytes_sent += (uint32_t)n;

	k_mutex_unlock(&encode_lock);
	k_sem_give(&tx_ready);
	return 0;
}

uint32_t sn_link_frames_sent(void)
{
	return frames_sent;
}

uint32_t sn_link_bytes_sent(void)
{
	return bytes_sent;
}

uint32_t sn_link_frames_dropped(void)
{
	return frames_dropped;
}
```

## src/link.h
```c
#pragma once

#include <stddef.h>
#include <stdint.h>

#include "frame.h"

/* Brings up the UART the host reads, and starts the reader that feeds
 * sn_link_set_command_handler. Returns 0, or -ENODEV if the device is not
 * ready. */
int sn_link_init(void);

/* Frames a payload and writes it. Assigns the sequence number itself, so
 * nothing above this layer has to track one -- which is also why the host
 * matches command replies by echoed command id rather than by sequence.
 * Returns 0 on success. */
int sn_link_send(sn_frame_type_t type, const uint8_t *payload, size_t len);

/* Called for the payload of each SN_FRAME_CONTROL_CMD that arrives. Runs on
 * the link's reader thread, never in an ISR, so it may block briefly. */
typedef void (*sn_command_handler_t)(const uint8_t *payload, size_t len);
void sn_link_set_command_handler(sn_command_handler_t handler);

/* Counters for the STATS frame. Kept here because this is the only place that
 * knows what actually reached the wire. */
uint32_t sn_link_frames_sent(void);
uint32_t sn_link_bytes_sent(void);

/* Frames refused because the outbound ring was full. Real loss, reported to
 * the host rather than hidden: a sniffer that quietly discards is worse than
 * one that says how much it discarded. */
uint32_t sn_link_frames_dropped(void);
```

## src/log_backend_sn.c
```c
/* Zephyr log output, redirected into the frame protocol.
 *
 * There is one UART and the capture stream owns it, so a log line written
 * directly would arrive as unframed bytes in the middle of a packet. The C6
 * solves the same problem the same way in firmware/main/log_sink.c; only the
 * SDK's API differs.
 *
 * DEFERRED mode is not a detail here, it is the whole safety argument. In
 * IMMEDIATE mode a log message is formatted in the context that logged it,
 * which for this driver includes its RX thread -- and that thread's default
 * 800-byte stack was measured at 792 bytes used, eight from the edge. Pushing
 * it over does not fault or complain: reception simply stops, while every API
 * call still reports success. That cost a night to find, and it is written up
 * in docs/2026-09-14-nrf54l15-spike.md. Deferred formatting happens on the
 * logging thread instead, and CONFIG_IEEE802154_NRF5_RX_STACK_SIZE is raised
 * beside it for margin rather than relying on that alone.
 */

#include <zephyr/logging/log_backend.h>
#include <zephyr/logging/log_backend_std.h>
#include <zephyr/logging/log_core.h>
#include <zephyr/logging/log_output.h>

#include "frame.h"
#include "link.h"

/* One formatted line. Longer messages are truncated by log_output rather than
 * overrunning, which is the behaviour we want: a clipped log is a nuisance, a
 * corrupted capture stream is a defect. */
#define SN_LOG_BUF_SIZE 192

static uint8_t buf[SN_LOG_BUF_SIZE];

/* log_output hands us formatted bytes; each call becomes one LOG frame. The
 * host decodes these as UTF-8 and the conformance suite checks that, so
 * whatever arrives here must be text. */
static int out(uint8_t *data, size_t length, void *ctx)
{
	ARG_UNUSED(ctx);

	sn_link_send(SN_FRAME_LOG, data, length);
	return (int)length;
}

LOG_OUTPUT_DEFINE(sn_log_output, out, buf, sizeof(buf));

static void process(const struct log_backend *const backend,
		    union log_msg_generic *msg)
{
	ARG_UNUSED(backend);

	const log_format_func_t func = log_format_func_t_get(LOG_OUTPUT_TEXT);

	func(&sn_log_output, &msg->log, log_backend_std_get_flags());
}

static void init_backend(const struct log_backend *const backend)
{
	ARG_UNUSED(backend);
}

static void panic(struct log_backend const *const backend)
{
	ARG_UNUSED(backend);

	log_backend_std_panic(&sn_log_output);
}

static void dropped(const struct log_backend *const backend, uint32_t cnt)
{
	ARG_UNUSED(backend);

	/* Says so in-band rather than silently. A host that is told it lost
	 * log lines can say so; one that is not will believe it saw
	 * everything. */
	log_backend_std_dropped(&sn_log_output, cnt);
}

static int format_set(const struct log_backend *const backend, uint32_t log_type)
{
	ARG_UNUSED(backend);

	/* Text only. The host decodes LOG payloads as UTF-8. */
	return log_type == LOG_OUTPUT_TEXT ? 0 : -ENOTSUP;
}

static const struct log_backend_api api = {
	.process = process,
	.panic = panic,
	.init = init_backend,
	.dropped = IS_ENABLED(CONFIG_LOG_MODE_IMMEDIATE) ? NULL : dropped,
	.format_set = format_set,
};

LOG_BACKEND_DEFINE(sn_log_backend, api, true);
```

## src/radio154.c
```c
/* IEEE 802.15.4 capture on the nRF54L15.
 *
 * Zephyr's raw 802.15.4 mode delivers every received frame to net_recv_data(),
 * which in RAW mode the application provides -- there is no network stack
 * above it. The API used here is transcribed from the NCS v3.4.0 sample rather
 * than remembered: net_recv_data returns int, not enum net_verdict, and the
 * PSDU comes from the buffer chain rather than from pkt->frags.
 *
 * Reception on this part is not supported by Nordic and was hard-won. Before
 * changing anything here, read docs/2026-09-14-nrf54l15-spike.md: two binaries
 * with byte-identical Kconfig differ deterministically, so if frames stop
 * arriving after an unrelated edit, that is the first thing to suspect.
 */

#include "radio154.h"

#include <errno.h>
#include <string.h>

#include <zephyr/kernel.h>
#include <zephyr/net/ieee802154_radio.h>
#include <zephyr/net/net_pkt.h>

#include <nrf_802154.h>

#include "frame.h"
#include "link.h"

static const struct device *const radio =
	DEVICE_DT_GET(DT_CHOSEN(zephyr_ieee802154));
static struct ieee802154_radio_api *api;

static uint8_t current_channel = 11;
static uint32_t captured;
static uint32_t dropped;

/* The largest PSDU an 802.15.4 frame can carry. */
#define SN_154_MAX_PSDU 127

int sn_radio154_init(void)
{
	if (!device_is_ready(radio)) {
		return -ENODEV;
	}
	api = (struct ieee802154_radio_api *)radio->api;
	if (api == NULL) {
		return -ENODEV;
	}

	/* Acknowledgements OFF, and this is not optional. The driver
	 * auto-acknowledges by default, which would make this board transmit.
	 * A sniffer that ACKs is not passive, and passivity is a claim this
	 * project makes. Nordic's own sample does this for the same reason. */
#if !IS_ENABLED(CONFIG_NRF_802154_SERIALIZATION)
	nrf_802154_auto_ack_set(false);
#endif

	/* Promiscuous, or the driver filters to frames addressed to us and a
	 * sniffer sees almost nothing. */
	struct ieee802154_config config = { .promiscuous = true };
	return api->configure(radio, IEEE802154_CONFIG_PROMISCUOUS, &config);
}

int sn_radio154_set_channel(uint8_t channel)
{
	/* Checked on the host too, but a board that trusts the wire is one
	 * corrupted byte away from tuning somewhere meaningless. */
	if (channel < 11u || channel > 26u) {
		return -EINVAL;
	}
	const int err = api->set_channel(radio, channel);
	if (err == 0) {
		current_channel = channel;
	}
	return err;
}

int sn_radio154_start(void)
{
	return api->start(radio);
}

int sn_radio154_stop(void)
{
	return api->stop(radio);
}

uint8_t sn_radio154_channel(void)
{
	return current_channel;
}

uint32_t sn_radio154_captured(void)
{
	return captured;
}

uint32_t sn_radio154_dropped(void)
{
	return dropped;
}

/* Every received frame arrives here. */
int net_recv_data(struct net_if *iface, struct net_pkt *pkt)
{
	ARG_UNUSED(iface);

	if (pkt == NULL) {
		return -EINVAL;
	}
	if (net_pkt_is_empty(pkt)) {
		net_pkt_unref(pkt);
		return -ENODATA;
	}

	const uint8_t *psdu = net_buf_frag_last(pkt->buffer)->data;
	size_t length = net_buf_frags_len(pkt->buffer);

	/* A net_ptp_time, seconds plus nanoseconds. There is no
	 * net_pkt_timestamp_ns() on this path. */
	struct net_ptp_time *pkt_time = net_pkt_timestamp(pkt);

	struct sn_154_meta meta = {
		.channel = current_channel,
		.lqi = net_pkt_ieee802154_lqi(pkt),
		.rssi_dbm = (int8_t)net_pkt_ieee802154_rssi_dbm(pkt),
		/* SN_154_FLAG_HAS_FCS stays clear: the driver strips the
		 * checksum before we see the frame, exactly as the C6's does,
		 * so claiming an FCS is present would be a lie the host would
		 * believe. */
		.flags = 0u,
		.timestamp_us = (uint64_t)pkt_time->second * 1000000ULL +
				(uint64_t)pkt_time->nanosecond / 1000ULL,
	};

	static uint8_t payload[sizeof(struct sn_154_meta) + SN_154_MAX_PSDU];

	if (length > SN_154_MAX_PSDU) {
		length = SN_154_MAX_PSDU;
	}
	memcpy(payload, &meta, sizeof(meta));
	memcpy(payload + sizeof(meta), psdu, length);

	captured++;
	if (sn_link_send(SN_FRAME_PACKET, payload, sizeof(meta) + length) != 0) {
		dropped++;
	}

	net_pkt_unref(pkt);
	return 0;
}

/* Acknowledgements are not traffic worth reporting, and in promiscuous mode
 * the stack asks what to do with them. */
enum net_verdict ieee802154_handle_ack(struct net_if *iface, struct net_pkt *pkt)
{
	ARG_UNUSED(iface);
	ARG_UNUSED(pkt);

	return NET_DROP;
}
```

## src/radio154.h
```c
#pragma once

#include <stdint.h>

/* Mirrors sn_154_meta_t in firmware/main/radio154.h, which the host unpacks as
 * "<BBbBQ" in capture.py. Packed because the host reads it as a flat
 * little-endian struct with no padding, and a field that moves here decodes
 * into a confident wrong number there rather than an error. */
struct __attribute__((packed)) sn_154_meta {
	uint8_t  channel;
	uint8_t  lqi;
	int8_t   rssi_dbm;
	uint8_t  flags;
	uint64_t timestamp_us;
};

/* Binds the radio and configures it for sniffing. Must be called before
 * sn_radio154_start(). Returns 0 on success. */
int sn_radio154_init(void);

int sn_radio154_set_channel(uint8_t channel);
int sn_radio154_start(void);
int sn_radio154_stop(void);

uint8_t sn_radio154_channel(void);

/* Counters for the STATS frame. */
uint32_t sn_radio154_captured(void);
uint32_t sn_radio154_dropped(void);
```
